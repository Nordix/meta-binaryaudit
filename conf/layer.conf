## conf/layer.conf
```bitbake
# We have a conf and classes directory, append to BBPATH
BBPATH .= ":${LAYERDIR}"

# We have a recipes directory, add to BBFILES
BBFILES += "${LAYERDIR}/recipes-*/*/*.bb ${LAYERDIR}/recipes-*/*/*.bbappend"

BBFILE_COLLECTIONS += "binary-audit-layer"
BBFILE_PATTERN_binary-audit-layer := "^${LAYERDIR}/"
BBFILE_PRIORITY_binary-audit-layer = "10"

LAYERDEPENDS_binary-audit-layer = "core"
LAYERSERIES_COMPAT_binary-audit-layer = "thud warrior zeus dunfell gatesgarth hardknott honister kirkstone scarthgap whinlatter"

BINARY_AUDIT_LAYERDIR = "${LAYERDIR}"
```
